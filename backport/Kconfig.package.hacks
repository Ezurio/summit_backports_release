## backport/Kconfig.package.hacks
```kconfig
# some hacks for when we use backports to generate a package
# to build modules out of tree.
config WIRELESS
	def_bool y
config NET_CORE
	def_bool y
config EXPERT
	def_bool y
config KUNIT
	def_bool n
```
